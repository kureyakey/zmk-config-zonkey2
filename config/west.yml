## config/west.yml
```yaml
manifest:
  remotes:
    - name: zmkfirmware
      url-base: https://github.com/zmkfirmware
    - name: cormoran
      url-base: https://github.com/cormoran
    - name: kureyakey
      url-base: https://github.com/kureyakey
    - name: caksoylar
      url-base: https://github.com/caksoylar  
  projects:
    - name: zmk
      remote: cormoran          
      revision: v0.3-branch+dya
      import: app/west.yml
    # モジュールを正しく認識させるため、URLを指定して追加
    - name: zmk-module-runtime-input-processor
      remote: cormoran
      revision: main
    - name: zmk-pmw3610-driver
      remote: kureyakey
      revision: main
    - name: zmk-rgbled-widget
      remote: caksoylar
      revision: v0.3
  self:
    path: config
```
